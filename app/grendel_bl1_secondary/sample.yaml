## app/grendel_bl1_secondary/sample.yaml
```yaml
sample:
  name: bl1_secondary
tests:
  sample.bl1_secondary:
    build_only: true
```

## boards/tenstorrent/tt_blackhole/tt_blackhole_tt_blackhole_smc_defconfig
```kconfig
# Copyright (c) 2024 Tenstorrent AI ULC
# SPDX-License-Identifier: Apache-2.0

# Enable RTT
CONFIG_USE_SEGGER_RTT=y

# enable console
CONFIG_CONSOLE=y
CONFIG_RTT_CONSOLE=y

# GPIO Controller
# CONFIG_GPIO=y

# Enable Clocks
#CONFIG_CLOCK_CONTROL=y

# enable i2c
CONFIG_I2C=y
CONFIG_I2C_DW_CLOCK_SPEED=50

# enable flash
CONFIG_FLASH=y

# enable external spi flash
CONFIG_FLASH_MSPI_NOR_RUNTIME_PROBE=y
# SPI designware controller on the SMC has a very small FIFO, which
# will routinely underflow if we try to perform large transfers. Limit
# the maximum program size to 15 bytes, so we never attempt a transfer with
# more than 15 bytes in the FIFO.
CONFIG_FLASH_MSPI_NOR_MAX_WRITE_SIZE=11
```

## drivers/flash/Kconfig
```kconfig
#  Copyright (c) 2025 Tenstorrent AI ULC
#  SPDX-License-Identifier: Apache-2.0

if FLASH

menu "Flash drivers"

# zephyr-keep-sorted-start
rsource "flash_mspi_nor/Kconfig"
# zephyr-keep-sorted-stop

endmenu

endif
```

## drivers/flash/Kconfig.mspi
```kconfig
# Copyright (c) 2024 Ambiq Micro Inc. <www.ambiq.com>
# SPDX-License-Identifier: Apache-2.0

menu "MSPI flash device driver"

menuconfig FLASH_MSPI_NOR
	bool "Generic MSPI NOR Flash"
	default y
	depends on DT_HAS_JEDEC_MSPI_NOR_ENABLED
	select FLASH_MSPI
	select FLASH_HAS_EXPLICIT_ERASE
	select FLASH_HAS_PAGE_LAYOUT
	select FLASH_JESD216
	select GPIO if $(dt_compat_any_has_prop,$(DT_COMPAT_JEDEC_MSPI_NOR),reset-gpios)

if FLASH_MSPI_NOR

config FLASH_MSPI_NOR_LAYOUT_PAGE_SIZE
	int "Page size to use for FLASH_LAYOUT feature"
	depends on FLASH_PAGE_LAYOUT
	default 65536
	help
	  When CONFIG_FLASH_PAGE_LAYOUT is used, this driver will support that
	  API. By default the page size corresponds to the block size (65536).
	  Other options include the 32K-byte erase size (32768), the sector
	  size (4096), or any non-zero multiple of the sector size.

config FLASH_MSPI_NOR_RUNTIME_PROBE
	bool "Probe flash details at runtime"
	help
	  If enabled, the driver will probe the flash device's JEDEC ID at
	  runtime, and used that to determine the command set and flash size.

config FLASH_MSPI_NOR_MAX_WRITE_SIZE
	int "Maximum write size for FLASH driver"
	default 65535
	help
	  This option sets the maximum program size the flash driver will use.
	  For some buggy MSPI controllers, this may need to be lowered to
	  ensure that writes do not fail. By default, up to UINT16_MAX
	  bytes can be programmed at once- note that the driver will
	  not program across page boundaries regardless of this setting.

endif # FLASH_MSPI_NOR

endmenu
```

## drivers/misc/tt_smc_remoteproc/Kconfig
```kconfig
# Copyright (c) 2025 Tenstorrent AI ULC
# SPDX-License-Identifier: Apache-2.0

config TT_SMC_REMOTEPROC
	bool "Tenstorrent SMC Remote Processor Driver"
	default y
	select I3C
	select GPIO
	depends on DT_HAS_TENSTORRENT_SMC_REMOTEPROC_ENABLED
	help
	  Enable the Remote Processor driver for the Tenstorrent SMC platform.

if TT_SMC_REMOTEPROC

config TT_SMC_REMOTEPROC_INIT_PRIO
	int
	default 75
	help
	  Set the initialization priority of the Tenstorrent SMC Remote Processor driver.

endif # TT_SMC_REMOTEPROC
```

## drivers/mspi/Kconfig.mspi_spi_dw
```kconfig
#  Copyright (c) 2025 Tenstorrent AI ULC
#  SPDX-License-Identifier: Apache-2.0

config MSPI_SPI_DW
	bool "SPI DW MSPI driver"
	default y
	depends on DT_HAS_SNPS_DESIGNWARE_SPI_ENABLED && !SPI_DW

if MSPI_SPI_DW

config MSPI_SPI_DW_SLAVE_COUNT
	int "Max number of SPI slaves"
	default 1
	range 1 32
	help
	  The maximum number of SPI slaves that can be connected to the
	  SPI DW MSPI driver. This is used to determine how many
	  tracking structures should be allocated for slave devices

endif # MSPI_SPI_DW
```

## lib/tenstorrent/occp/Kconfig
```kconfig
# Copyright (c) 2026 Tenstorrent AI ULC
# SPDX-License-Identifier: Apache-2.0

config OCCP
	bool "OCCP Subsystem"
	select CRC # Required for header checksum calculations
	help
	  Enable support for the OCCP (Open Chiplet Configuration Protocol)
	  subsystem

module = OCCP
module-str = occp
source "subsys/logging/Kconfig.template.log_config"
```

## subsys/tracing/Kconfig
```kconfig
# Tracing configuration options

# Copyright (c) 2025 Tenstorrent Inc.
# SPDX-License-Identifier: Apache-2.0

choice TRACING_BACKEND_CHOICE

config TRACING_BACKEND_RINGBUF
	bool "Ring Buffer tracing backend"
	help
	  Enable tracing using the Ring Buffer backend. This backend places
	  data into a ring buffer in RAM, which can be read by an external
	  host system. The host system is reponsible for updating the ring
	  buffer head pointer to indicate how much data has been read.

endchoice

config TRACING_BACKEND_NAME
	string
	default "tracing_backend_ringbuf" if TRACING_BACKEND_RINGBUF

config RINGBUF_TRACING_BUFFER_SIZE
	int "Size of the tracing buffer in bytes"
	depends on TRACING_BACKEND_RINGBUF
	default 8192
	help
	  Size of the ring buffer used for tracing. Data will be discarded
	  if space does not exist in the buffer when new data arrives.

config TRACING_BACKEND_TT
	bool "Tenstorrent tracing backend"
	depends on TRACING_BACKEND_RINGBUF
	help
	  Enable the Tenstorrent tracing backend, which will expose the
	  tracing buffer to the host system via a specific scratch register.
```
